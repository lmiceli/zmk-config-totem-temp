
    // MOUSE CONFIG
    #define U_MOUSE_MOVE_MAX 1400                     /* <--- New max speed setting (default: 600) */
    #undef MOVE_UP
    #undef MOVE_DOWN
    #undef MOVE_LEFT
    #undef MOVE_RIGHT
    #define MOVE_UP MOVE_Y(-U_MOUSE_MOVE_MAX)
    #define MOVE_DOWN MOVE_Y(U_MOUSE_MOVE_MAX)
    #define MOVE_LEFT MOVE_X(-U_MOUSE_MOVE_MAX)
    #define MOVE_RIGHT MOVE_X(U_MOUSE_MOVE_MAX)
    &mmv {
        time-to-max-speed-ms = <400>;
    };

    #define U_MOUSE_SCROLL_MAX 100                    /* <--- New max speed setting (default: 10) */

    #undef SCROLL_UP
    #undef SCROLL_DOWN
    #undef SCROLL_LEFT
    #undef SCROLL_RIGHT
    #define SCROLL_UP SCROLL_Y(U_MOUSE_SCROLL_MAX)
    #define SCROLL_DOWN SCROLL_Y(-U_MOUSE_SCROLL_MAX)
    #define SCROLL_LEFT SCROLL_X(-U_MOUSE_SCROLL_MAX)
    #define SCROLL_RIGHT SCROLL_X(U_MOUSE_SCROLL_MAX)

//    &msc {
        //acceleration-exponent=<1>;
//    };